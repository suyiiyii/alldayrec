## firmware/devkit/Kconfig
```kconfig
source "Kconfig.zephyr"

menu "Omi Features Configuration"

config OMI_CODEC_OPUS
    bool "Opus Audio Codec"
    help
        "Enable the Opus audio codec support."
    default n

config OMI_ENABLE_OFFLINE_STORAGE
	bool "Offline SD Card Storage"
    select DISK_ACCESS
    select FILE_SYSTEM
    select FAT_FILESYSTEM_ELM
    select FS_FATFS_MOUNT_MKFS
    select FS_FATFS_EXFAT
    help
        "Enable the offline storage support. Requires a SD Card."
	default n

config OMI_ENABLE_ACCELEROMETER
    bool "Accelerometer Support"
    help
        "Enable the accelerometer support."
    default n

config OMI_ENABLE_BUTTON
    bool "Button support"
    help
        "Enable the software button support."
    default n

config OMI_ENABLE_SPEAKER
    bool "Enable the speaker"
    help
        "Enable the speaker support."
    default n

config OMI_ENABLE_BATTERY
    bool "Enable the battery"
    help
        "Enable the battery support."
    default n

config LR_NAME_PREFIX
    string "Board name: the BLE name is this plus the last two address bytes, e.g. LR-X1-3F2A"
    default "LR-X1"

config LR_STORE_RESERVE_KB
    int "Offline store: stop recording when the SD card has less than this free (KB); resume at twice it"
    default 1024

config LR_STORE_BATCH
    int "Record stream: finished records gather in RAM until this many bytes (4 KB is ~1 s of audio), then go to the card in one write"
    default 4096

config LR_STORE_PHONE
    bool "Phone mode: a phone that acks what it has stored (CTRL ACK) takes the stream instead of the SD card; what it has not acked waits in RAM (~11 s), and goes to the card when the link goes, the ACKs stop or that RAM is 3/4 full (lr_store.c)"
    default n

config LR_STORE_CARD_OFF
    bool "Phone mode turns the SD card's supply off (sd-pwr-gpios) while the card is idle; off: the card stays on, only not written"
    depends on LR_STORE_PHONE
    default y

config LR_SDHC_SPI
    bool "SD card over SPI by src/sdhc_spi.c: NCS 2.7's driver without its 10 and 30 ms sleeps per command"
    default y
    depends on DT_HAS_ZEPHYR_SDHC_SPI_SLOT_ENABLED && !SPI_SDHC
    select SPI
    select CRC
    select SDHC_SUPPORTS_SPI_MODE

config LR_BATTERY_VDDH
    bool "Battery on VDDH (nice!nano): read VDDH/5 inside the chip, no divider or charger pins"
    default n

config LR_SWITCH
    bool "LR-P3's slide switch on P1.15 (closed to GND = on): off stops recording and goes to System OFF (lr_switch.c)"
    depends on OMI_ENABLE_USB
    default n
    help
        "Only on a board with the switch wired: elsewhere P1.15 is open and reads off, and the board would never record."

config LR_LOW_BATTERY_MV
    int "On battery, three readings a minute apart under this many mV end recording and go to System OFF until USB, or LR-P3's switch, wakes it (lr_power.c); 0: never"
    default 3300

config LR_POWER_TRACE
    bool "On battery a POWER log record with VDDH every minute, and the power-fail warning, written to flash at once (lr_power.c)"
    depends on LR_BATTERY_VDDH
    default n

config LR_ONE_LED
    bool "One LED (the ProMicro's P0.15, led2): the status as short flashes (led_code.h) instead of the XIAO's RGB"
    default n

config OMI_ENABLE_USB
    bool "Enable the usb"
    help
        "Enable the USB power check support."
    default n

config OMI_ENABLE_HAPTIC
    bool "Enable the haptic"
    help
        "Enable the haptic support."
    default n

endmenu
```
